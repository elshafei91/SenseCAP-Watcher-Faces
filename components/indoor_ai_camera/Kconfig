## components/indoor_ai_camera/Kconfig
```kconfig
menu "Indoor AI Camera BSP"

    config BSP_ERROR_CHECK
    bool "Enable error check in BSP"
    default y
    help
        Error check assert the application before returning the error code.

    config BSP_AUDIO_MIC_VALUE_GAIN
    int "Audio mic value gain"
    range 0 3
    default 0
    help
        "Audio mic value gain"

    config LVGL_DRAW_BUFF_HEIGHT
        int "LVGL DRAW BUFF HEIGHT(ROWS)"
        range 10 240
        default 50
        help
            "LVGL draw buffer height(rows)"

    config LVGL_INPUT_DEVICE_USE_KNOB
        bool "LVGL INPUT DEVICE USE KNOB"
        default y
        help
            "Enable to use knob as LVGL input device"

    config LVGL_INPUT_DEVICE_USE_TP
        bool "LVGL INPUT DEVICE USE TP"
        default y
        help
            "Enable to use touchpad as LVGL input device"

endmenu
```

## components/sensecap-watcher/Kconfig
```kconfig
menu "SenseCAP Watcher BSP Configuration"

    config BSP_ERROR_CHECK
    bool "Enable error check in BSP"
    default y
    help
        Error check assert the application before returning the error code.

    config BSP_AUDIO_MIC_VALUE_GAIN
    int "Audio mic value gain"
    range 0 3
    default 0
    help
        "Audio mic value gain"

    menu "BSP LVGL Configuration"

        config LVGL_DRAW_BUFF_HEIGHT
            int "LVGL DRAW BUFF HEIGHT(ROWS)"
            range 40 412
            default 412
            help
                "LVGL draw buffer height(rows)"
        
        config LVGL_TASK_STACK_SIZE
            int "LVGL TASK STACK SIZE"
            range 4096 40960
            default 10240
            help
                "LVGL task stack size"

        config LVGL_INPUT_DEVICE_USE_KNOB
            bool "LVGL INPUT DEVICE USE KNOB"
            default y
            help
                "Enable to use knob as LVGL input device"

        config LVGL_INPUT_DEVICE_USE_TP
            bool "LVGL INPUT DEVICE USE TP"
            default y
            help
                "Enable to use touchpad as LVGL input device"
    
    endmenu


    menu "SSCMA Client Configuration"

    config SSCMA_ENABLE_DEBUG_LOG
        bool "Enable debug log"
            default n
            help
                Wether to enable the debug log message for SSCMA Client driver.
                Note that, this option only controls the SSCMA Client driver log, won't affect other drivers.


    config SSCMA_EVENT_QUEUE_SIZE
        int "SSCMA Client event queue size"
        range 1 10
        default 2
        help
            Config SSCMA Client event queue size

    config SSCMA_TX_BUFFER_SIZE
        int "SSCMA Client TX Buffer Size"
        range 4096 10240
        default 4096
        help
            Config SSCMA TX buffer size
    
     config SSCMA_RX_BUFFER_SIZE
        int "SSCMA Client RX Buffer Size"
        range 32768 131072
        default 65536
        help
            Config SSCMA RX buffer size
    
    menu "SSCMA Client Process Task"
        config SSCMA_PROCESS_TASK_STACK_SIZE
            int "Stack Size"
            range 4096 10240
            default 4096
            help
                Config process task stack size in different applications

        config SSCMA_PROCESS_TASK_PRIORITY
            int "Task Priority"
            range 1 25
            default 5
            help
                Sets the process task priority

        choice SSCMA_PROCESS_TASK_AFFINITY
            prompt "Core Affinity"
            default SSCMA_PROCESS_TASK_AFFINITY_NO_AFFINTY
            help 
                Configure the "process task" core affinity. 

            config SSCMA_PROCESS_TASK_AFFINITY_CPU0
                bool "CPU0"
            config SSCMA_PROCESS_TASK_AFFINITY_CPU1
                bool "CPU1"
                depends on !FREERTOS_UNICORE
            config SSCMA_PROCESS_TASK_AFFINITY_NO_AFFINTY
                bool "No affinity"
        endchoice

        config SSCMA_PROCESS_TASK_AFFINITY
            hex
            default 0x0 if SSCMA_PROCESS_TASK_AFFINITY_CPU0
            default 0x1 if SSCMA_PROCESS_TASK_AFFINITY_CPU1
            default FREERTOS_NO_AFFINITY if SSCMA_PROCESS_TASK_AFFINITY_NO_AFFINTY

        config SSCMA_PROCESS_TASK_STACK_ALLOC_EXTERNAL
            bool "External SPIRAM"
            default n
            select SPIRAM_ALLOW_STACK_EXTERNAL_MEMORY
            help
               Enable this option to allocate the task stack from external memory by default
    endmenu

    menu "SSCMA Client Monitor Task"
        config SSCMA_MONITOR_TASK_STACK_SIZE
            int "Stack Size"
            range 4096 10240
            default 4096
            help
                Config monitor task stack size in different applications

        config SSCMA_MONITOR_TASK_PRIORITY
            int "Task Priority"
            range 1 25
            default 5
            help
                Sets the monitor task priority

        choice SSCMA_MONITOR_TASK_AFFINITY
            prompt "Core Affinity"
            default SSCMA_MONITOR_TASK_AFFINITY_NO_AFFINTY
            help 
                Configure the "process task" core affinity. 

            config SSCMA_MONITOR_TASK_AFFINITY_CPU0
                bool "CPU0"
            config SSCMA_MONITOR_TASK_AFFINITY_CPU1
                bool "CPU1"
                depends on !FREERTOS_UNICORE
            config SSCMA_MONITOR_TASK_AFFINITY_NO_AFFINTY
                bool "No affinity"
        endchoice

        config SSCMA_MONITOR_TASK_AFFINITY
            hex
            default 0x0 if SSCMA_MONITOR_TASK_AFFINITY_CPU0
            default 0x1 if SSCMA_MONITOR_TASK_AFFINITY_CPU1
            default FREERTOS_NO_AFFINITY if SSCMA_MONITOR_TASK_AFFINITY_NO_AFFINTY


        config SSCMA_MONITOR_TASK_STACK_ALLOC_EXTERNAL
            bool "External SPIRAM"
            default n
            select SPIRAM_ALLOW_STACK_EXTERNAL_MEMORY
            help
                Enable this option to allocate the task stack from external memory by default
    endmenu

endmenu

endmenu
```

## examples/factory_firmware/main/Kconfig.projbuild
```kconfig
menu "Factory Firmware Example Configuration"
    config VOICE_ID
        string "Speaker Id"
        default "qiumum_0gushi"
        help
            speaker id from https://czyt.tech/post/a-free-tts-api/?from_wecom=1
    config VOLUME_LEVEL
        int "volume level"
        default "90"
        range 1 100
        help
            speaker volume
    config ENABLE_FACTORY_FW_DEBUG_LOG
        bool "Enable debug log level for this example project"
        default "n"
        help
            Enable debug log level for this factory firmware example project

    config SKIP_COMMON_NAME_CHECK
        bool "Skip server certificate Common Name field check"
        default n
        help
            This allows you to skip the validation of OTA server certificate CommonName field. But please don't enable this if the cert of your OTA server needs SNI support.
endmenu
```

## examples/openai-realtime/sdkconfig.defaults
```kconfig
# ESP Event Loop on Linux
CONFIG_ESP_EVENT_POST_FROM_ISR=n
CONFIG_ESP_EVENT_POST_FROM_IRAM_ISR=n

# Disable TLS verification
# Production needs to include specific cert chain you care about
CONFIG_ESP_TLS_INSECURE=y
CONFIG_ESP_TLS_SKIP_SERVER_CERT_VERIFY=y

# Enable DTLS-SRTP
CONFIG_MBEDTLS_SSL_PROTO_DTLS=y

# libpeer requires large stack allocations
CONFIG_ESP_MAIN_TASK_STACK_SIZE=16384

# Defaults to partitions.csv
CONFIG_PARTITION_TABLE_CUSTOM=y

# Set highest CPU Freq
CONFIG_ESP_DEFAULT_CPU_FREQ_MHZ_240=y

CONFIG_SPIRAM=y
CONFIG_SPIRAM_MODE_OCT=y

# Disable Watchdog
# CONFIG_ESP_INT_WDT is not set
# CONFIG_ESP_TASK_WDT_EN is not set

# Enable Compiler Optimization
CONFIG_COMPILER_OPTIMIZATION_PERF=y
CONFIG_COMPILER_OPTIMIZATION_ASSERTIONS_DISABLE=y


CONFIG_IDF_TARGET="esp32s3"
CONFIG_LV_COLOR_16_SWAP=y
CONFIG_ESPTOOLPY_FLASH_MODE_AUTO_DETECT=n
CONFIG_ESPTOOLPY_FLASHMODE_QIO=y
CONFIG_ESPTOOLPY_FLASHSIZE_32MB=y
CONFIG_PARTITION_TABLE_CUSTOM=y
CONFIG_SPIRAM=y
CONFIG_SPIRAM_MODE_OCT=y
CONFIG_SPIRAM_SPEED_80M=y
CONFIG_SPIRAM_MALLOC_ALWAYSINTERNAL=1024
CONFIG_SPIRAM_TRY_ALLOCATE_WIFI_LWIP=y
CONFIG_SPIRAM_MALLOC_RESERVE_INTERNAL=262144
CONFIG_SPIRAM_ALLOW_BSS_SEG_EXTERNAL_MEMORY=y
CONFIG_ESP_DEFAULT_CPU_FREQ_MHZ_240=y
```

## examples/speech_recognize/sdkconfig.defaults
```kconfig
CONFIG_IDF_TARGET="esp32s3"
CONFIG_IDF_TARGET_ESP32S3=y
CONFIG_LV_COLOR_16_SWAP=y

CONFIG_SPIRAM=y
CONFIG_SPIRAM_MODE_OCT=y
CONFIG_SPIRAM_SPEED_80M=y
CONFIG_ESP32S3_DEFAULT_CPU_FREQ_240=y
CONFIG_ESP32S3_INSTRUCTION_CACHE_32KB=y
CONFIG_ESP32S3_DATA_CACHE_64KB=y
CONFIG_ESP32S3_DATA_CACHE_LINE_64B=y

CONFIG_ESPTOOLPY_FLASHSIZE_4MB=y
CONFIG_PARTITION_TABLE_CUSTOM=y
CONFIG_PARTITION_TABLE_CUSTOM_FILENAME="partitions.csv"
CONFIG_PARTITION_TABLE_FILENAME="partitions.csv"

CONFIG_MODEL_IN_SPIFFS=y
# CONFIG_MODEL_IN_SDCARD is not set
CONFIG_USE_WAKENET=y
CONFIG_SR_WN_LOAD_MULIT_WORD=y
CONFIG_SR_WN_WN9_HIESP_MULTI=y
CONFIG_SR_WN_WN9_COMPUTER_TTS_MULTI=y
# CONFIG_USE_MULTINET is not set

CONFIG_LVGL_INPUT_DEVICE_USE_KNOB=n
```
